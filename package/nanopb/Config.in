## package/nanopb/Config.in
```kconfig
config BR2_PACKAGE_NANOPB
	bool "nanopb"
	depends on BR2_PACKAGE_PROTOBUF
	depends on BR2_PACKAGE_PYTHON_PROTOBUF
```

## package/pblog/Config.in
```kconfig
config BR2_PACKAGE_PBLOG
	bool "pblog"
	help
	  Pblog is a protobuf based logging library.

	  https://github.com/google/pblog
```
